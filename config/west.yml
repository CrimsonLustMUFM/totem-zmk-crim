## config/west.yml
```yaml
manifest:
  remotes:
    - name: danielsvane
      url-base: https://github.com/danielsvane
    - name: caksoylar
      url-base: https://github.com/caksoylar    
  
  projects:
    - name: zmk
      remote: danielsvane
      revision: customkeyboards
      import: app/west.yml
    - name: zmk-rgbled-widget
      remote: caksoylar
      revision: main
      
  self:
    path: config
```
